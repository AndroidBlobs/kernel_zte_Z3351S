/*
 * when you want to delete some nodes or property, modify this dtsi.
 * some diff between mtk and zte pluto.
 */

/{
	ext_speaker_amp_info {
		status="okay";
		compatible = "zte,ext-speaker-amp-info";
		zte,ext-spk-amp-mode = <3>;
	};
};

&charger {
	/delete-property/ enable_pe_plus;
	/delete-property/ enable_pe_2;
	/delete-property/ enable_pe_3;
};
